## fw/modules/metar_cpp/Kconfig
```kconfig
config METAR_CPP
	bool "metar_cpp METAR decoder library"
	depends on CPP
	select REQUIRES_FULL_LIBCPP
	help
	  Builds the METAR decoder from au/metar_cpp (C++17, no exceptions).
```

## fw/tests/lib/sign/testcase.yaml
```yaml
common:
  tags: ws lib golden
  platform_allow:
    - native_sim/native/64
  integration_platforms:
    - native_sim/native/64
tests:
  ws.lib.sign: {}
```

## fw/tests/lib/ui/testcase.yaml
```yaml
common:
  tags: ws lib
  platform_allow:
    - native_sim/native/64
  integration_platforms:
    - native_sim/native/64
tests:
  ws.lib.ui: {}
```
